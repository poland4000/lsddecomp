SECTIONS
{
    __romPos = 0;
    _gp = 0x8008A808;
    header_ROM_START = __romPos;
    header_VRAM = ADDR(.header);
    .header : AT(header_ROM_START) SUBALIGN(2)
    {
        FILL(0x00000000);
        header_DATA_START = .;
        build/asm/lsdde/header.s.o(.data);
        header_DATA_END = .;
        header_DATA_SIZE = ABSOLUTE(header_DATA_END - header_DATA_START);
    }
    __romPos += SIZEOF(.header);
    header_ROM_END = __romPos;
    header_VRAM_END = .;

    main_ROM_START = __romPos;
    main_VRAM = ADDR(.main);
    .main 0x80010000 : AT(main_ROM_START) SUBALIGN(2)
    {
        FILL(0x00000000);
        main_RODATA_START = .;
        build/asm/lsdde/data/800.rodata.s.o(.rodata);
        build/asm/lsdde/data/A8C.rodata.s.o(.rodata);
        build/asm/lsdde/data/ABC.rodata.s.o(.rodata);
        build/asm/lsdde/data/F28.rodata.s.o(.rodata);
        build/asm/lsdde/data/FA4.rodata.s.o(.rodata);
        build/asm/lsdde/data/FD8.rodata.s.o(.rodata);
        build/asm/lsdde/data/1764.rodata.s.o(.rodata);
        build/asm/lsdde/data/1890.rodata.s.o(.rodata);
        build/asm/lsdde/data/19DC.rodata.s.o(.rodata);
        build/asm/lsdde/data/1A90.rodata.s.o(.rodata);
        build/asm/lsdde/data/1C0C.rodata.s.o(.rodata);
        build/asm/lsdde/data/1E28.rodata.s.o(.rodata);
        build/asm/lsdde/data/1EF4.rodata.s.o(.rodata);
        build/src/lsdde/DreamSys.c.o(.rodata);
        build/asm/lsdde/data/206C.rodata.s.o(.rodata);
        build/src/lsdde/main.c.o(.rodata);
        build/asm/lsdde/psyq_2258.s.o(.rodata);
        build/src/lsdde/8220.c.o(.rodata);
        build/asm/lsdde/psyq_rcpolyf3.s.o(.rodata);
        build/asm/lsdde/psyq_rcpolyf4.s.o(.rodata);
        build/asm/lsdde/psyq_rcpolyg3.s.o(.rodata);
        build/asm/lsdde/psyq_rcpolyft3.s.o(.rodata);
        build/asm/lsdde/psyq_rcpolygt3.s.o(.rodata);
        build/src/lsdde/D294.c.o(.rodata);
        build/asm/lsdde/psyq_GsLinkObject4.s.o(.rodata);
        build/asm/lsdde/psyq_15d04.s.o(.rodata);
        build/src/lsdde/class_16334.c.o(.rodata);
        build/asm/lsdde/psyq_PadInit.s.o(.rodata);
        build/src/lsdde/1677C.c.o(.rodata);
        build/src/lsdde/171E0.c.o(.rodata);
        build/src/lsdde/179D8.c.o(.rodata);
        build/asm/lsdde/psyq_SpuSetMute.s.o(.rodata);
        build/src/lsdde/2C054.c.o(.rodata);
        build/asm/lsdde/psyq_memset.s.o(.rodata);
        build/asm/lsdde/psyq_rand.s.o(.rodata);
        build/src/lsdde/StageGrid.c.o(.rodata);
        build/src/lsdde/class_39e08.c.o(.rodata);
        build/src/lsdde/4cd08.c.o(.rodata);
        build/src/lsdde/Entity.c.o(.rodata);
        build/src/lsdde/55DD4.c.o(.rodata);
        . = ALIGN(., 4);
        main_RODATA_END = .;
        main_RODATA_SIZE = ABSOLUTE(main_RODATA_END - main_RODATA_START);
        main_TEXT_START = .;
        build/src/lsdde/main.c.o(.text);
        build/asm/lsdde/psyq_2258.s.o(.text);
        build/src/lsdde/8220.c.o(.text);
        build/asm/lsdde/psyq_rcpolyf3.s.o(.text);
        build/asm/lsdde/psyq_rcpolyf4.s.o(.text);
        build/asm/lsdde/psyq_rcpolyg3.s.o(.text);
        build/asm/lsdde/psyq_rcpolyft3.s.o(.text);
        build/asm/lsdde/psyq_rcpolygt3.s.o(.text);
        build/src/lsdde/D294.c.o(.text);
        build/asm/lsdde/psyq_GsLinkObject4.s.o(.text);
        build/asm/lsdde/psyq_15d04.s.o(.text);
        build/src/lsdde/class_16334.c.o(.text);
        build/asm/lsdde/psyq_PadInit.s.o(.text);
        build/src/lsdde/1677C.c.o(.text);
        build/src/lsdde/171E0.c.o(.text);
        build/src/lsdde/179D8.c.o(.text);
        build/asm/lsdde/psyq_SpuSetMute.s.o(.text);
        build/src/lsdde/2C054.c.o(.text);
        build/asm/lsdde/psyq_memset.s.o(.text);
        build/asm/lsdde/psyq_rand.s.o(.text);
        build/src/lsdde/StageGrid.c.o(.text);
        build/src/lsdde/class_39e08.c.o(.text);
        build/src/lsdde/DreamSys.c.o(.text);
        build/src/lsdde/4cd08.c.o(.text);
        build/src/lsdde/Entity.c.o(.text);
        build/src/lsdde/55DD4.c.o(.text);
        . = ALIGN(., 4);
        main_TEXT_END = .;
        main_TEXT_SIZE = ABSOLUTE(main_TEXT_END - main_TEXT_START);
        main_DATA_START = .;
        build/asm/lsdde/data/800.rodata.s.o(.data);
        build/asm/lsdde/data/A8C.rodata.s.o(.data);
        build/asm/lsdde/data/ABC.rodata.s.o(.data);
        build/asm/lsdde/data/F28.rodata.s.o(.data);
        build/asm/lsdde/data/FA4.rodata.s.o(.data);
        build/asm/lsdde/data/FD8.rodata.s.o(.data);
        build/asm/lsdde/data/1764.rodata.s.o(.data);
        build/asm/lsdde/data/1890.rodata.s.o(.data);
        build/asm/lsdde/data/19DC.rodata.s.o(.data);
        build/asm/lsdde/data/1A90.rodata.s.o(.data);
        build/asm/lsdde/data/1C0C.rodata.s.o(.data);
        build/asm/lsdde/data/1E28.rodata.s.o(.data);
        build/asm/lsdde/data/1EF4.rodata.s.o(.data);
        build/asm/lsdde/data/57070.data.s.o(.data);
        build/src/lsdde/StageGrid.c.o(.data);
        build/src/lsdde/class_39e08.c.o(.data);
        build/src/lsdde/4cd08.c.o(.data);
        build/src/lsdde/Entity.c.o(.data);
        build/src/lsdde/55DD4.c.o(.data);
        build/asm/lsdde/data/76DC8.data.s.o(.data);
        build/asm/lsdde/data/DreamSys.data.s.o(.data);
        build/asm/lsdde/data/206C.rodata.s.o(.data);
        build/src/lsdde/main.c.o(.data);
        build/asm/lsdde/psyq_2258.s.o(.data);
        build/src/lsdde/8220.c.o(.data);
        build/asm/lsdde/psyq_rcpolyf3.s.o(.data);
        build/asm/lsdde/psyq_rcpolyf4.s.o(.data);
        build/asm/lsdde/psyq_rcpolyg3.s.o(.data);
        build/asm/lsdde/psyq_rcpolyft3.s.o(.data);
        build/asm/lsdde/psyq_rcpolygt3.s.o(.data);
        build/src/lsdde/D294.c.o(.data);
        build/asm/lsdde/psyq_GsLinkObject4.s.o(.data);
        build/asm/lsdde/psyq_15d04.s.o(.data);
        build/src/lsdde/class_16334.c.o(.data);
        build/asm/lsdde/psyq_PadInit.s.o(.data);
        build/src/lsdde/1677C.c.o(.data);
        build/src/lsdde/171E0.c.o(.data);
        build/src/lsdde/179D8.c.o(.data);
        build/asm/lsdde/psyq_SpuSetMute.s.o(.data);
        build/src/lsdde/2C054.c.o(.data);
        build/asm/lsdde/psyq_memset.s.o(.data);
        build/asm/lsdde/psyq_rand.s.o(.data);
        build/asm/lsdde/data/79528.data.s.o(.data);
        . = ALIGN(., 4);
        main_DATA_END = .;
        main_DATA_SIZE = ABSOLUTE(main_DATA_END - main_DATA_START);
        main_SDATA_START = .;
        build/asm/lsdde/data/7B008.sdata.s.o(.sdata);
        build/asm/lsdde/data/DreamSys.sdata.s.o(.sdata);
        build/asm/lsdde/data/7B3F8.sdata.s.o(.sdata);
        . = ALIGN(., 4);
        main_SDATA_END = .;
        main_SDATA_SIZE = ABSOLUTE(main_SDATA_END - main_SDATA_START);
        main_SBSS_START = .;
        build/asm/lsdde/data/7B420.sbss.s.o(.sbss);
        build/asm/lsdde/data/7B468.sbss.s.o(.sbss);
        build/asm/lsdde/data/7B46C.sbss.s.o(.sbss);
        build/src/lsdde/DreamSys.c.o(.sbss);
        build/asm/lsdde/data/7B4CC.sbss.s.o(.sbss);
        . = ALIGN(., 4);
        main_SBSS_END = .;
        main_SBSS_SIZE = ABSOLUTE(main_SBSS_END - main_SBSS_START);
        main_BSS_START = .;
        build/asm/lsdde/data/800.rodata.s.o(.bss);
        build/asm/lsdde/data/A8C.rodata.s.o(.bss);
        build/asm/lsdde/data/ABC.rodata.s.o(.bss);
        build/asm/lsdde/data/F28.rodata.s.o(.bss);
        build/asm/lsdde/data/FA4.rodata.s.o(.bss);
        build/asm/lsdde/data/FD8.rodata.s.o(.bss);
        build/asm/lsdde/data/1764.rodata.s.o(.bss);
        build/asm/lsdde/data/1890.rodata.s.o(.bss);
        build/asm/lsdde/data/19DC.rodata.s.o(.bss);
        build/asm/lsdde/data/1A90.rodata.s.o(.bss);
        build/asm/lsdde/data/1C0C.rodata.s.o(.bss);
        build/asm/lsdde/data/1E28.rodata.s.o(.bss);
        build/asm/lsdde/data/1EF4.rodata.s.o(.bss);
        build/src/lsdde/DreamSys.c.o(.bss);
        build/asm/lsdde/data/206C.rodata.s.o(.bss);
        build/src/lsdde/main.c.o(.bss);
        build/asm/lsdde/psyq_2258.s.o(.bss);
        build/src/lsdde/8220.c.o(.bss);
        build/asm/lsdde/psyq_rcpolyf3.s.o(.bss);
        build/asm/lsdde/psyq_rcpolyf4.s.o(.bss);
        build/asm/lsdde/psyq_rcpolyg3.s.o(.bss);
        build/asm/lsdde/psyq_rcpolyft3.s.o(.bss);
        build/asm/lsdde/psyq_rcpolygt3.s.o(.bss);
        build/src/lsdde/D294.c.o(.bss);
        build/asm/lsdde/psyq_GsLinkObject4.s.o(.bss);
        build/asm/lsdde/psyq_15d04.s.o(.bss);
        build/src/lsdde/class_16334.c.o(.bss);
        build/asm/lsdde/psyq_PadInit.s.o(.bss);
        build/src/lsdde/1677C.c.o(.bss);
        build/src/lsdde/171E0.c.o(.bss);
        build/src/lsdde/179D8.c.o(.bss);
        build/asm/lsdde/psyq_SpuSetMute.s.o(.bss);
        build/src/lsdde/2C054.c.o(.bss);
        build/asm/lsdde/psyq_memset.s.o(.bss);
        build/asm/lsdde/psyq_rand.s.o(.bss);
        build/src/lsdde/StageGrid.c.o(.bss);
        build/src/lsdde/class_39e08.c.o(.bss);
        build/src/lsdde/4cd08.c.o(.bss);
        build/src/lsdde/Entity.c.o(.bss);
        build/src/lsdde/55DD4.c.o(.bss);
        . = ALIGN(., 4);
        main_BSS_END = .;
        main_BSS_SIZE = ABSOLUTE(main_BSS_END - main_BSS_START);
    }
    __romPos += SIZEOF(.main);
    __romPos = ALIGN(__romPos, 4);
    . = ALIGN(., 4);
    main_ROM_END = __romPos;
    main_VRAM_END = .;

    /DISCARD/ :
    {
        *(*);
    }
}
